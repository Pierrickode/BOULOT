## meta-appligps/conf/layer.conf
```bitbake
# Layer configuration for meta-appligps
BBPATH .= ":${LAYERDIR}"

BBFILES += "${LAYERDIR}/recipes-*/*/*.bb \
            ${LAYERDIR}/recipes-*/*/*.bbappend"

BBFILE_COLLECTIONS += "meta-appligps"
BBFILE_PATTERN_meta-appligps = "^${LAYERDIR}/"
BBFILE_PRIORITY_meta-appligps = "10"

LAYERVERSION_meta-appligps = "1"
LAYERSERIES_COMPAT_meta-appligps = "dunfell kirkstone mickledore scarthgap"
```
